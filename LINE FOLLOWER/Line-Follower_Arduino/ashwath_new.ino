//int sB=5;
int mbb=9;
int mbf=6;
int maf=3;
int mab=5;
int cnt;
//int sA=10;

int rso=A0;//yellow
//int rsi=A5;//white
int ms=A1;//green
//int lsi=A4;//brown




int lso=A2;//blue

void setup() {
  //pinMode(sB,OUTPUT);
  Serial.begin(9600);
  pinMode(mbf,OUTPUT);
  pinMode(mbb,OUTPUT);
  pinMode(maf,OUTPUT);
  pinMode(mab,OUTPUT);
  //pinMode(sA,OUTPUT);
  //pinMode(rsi,INPUT);
  pinMode(rso,INPUT);
  pinMode(lso,INPUT);
  pinMode(ms,INPUT);
  //pinMode(lsi,INPUT);
  //analogWrite(sB,125);
  //analogWrite(sA,125);
}

void forward(){
  analogWrite(maf,70);
  analogWrite(mab,0);
  analogWrite(mbf,70);
  analogWrite(mbb,0);
}

void stop(){
  analogWrite(maf,100);
  analogWrite(mab,0);
  analogWrite(mbf,0);
  analogWrite(mbb,100);
}

void left(){
  analogWrite(mbf,110);
  analogWrite(mab,0);
  analogWrite(maf,0);
  analogWrite(mbb,0);
}

void right(){
  analogWrite(mbf,0);
  analogWrite(mab,0);
  analogWrite(maf,110);
  analogWrite(mbb,0);
}
void rotate_left(){
  analogWrite(mbf,70);
  analogWrite(mab,0);
  analogWrite(maf,0);
  analogWrite(mbb,0);
  }
void rotate_right(){
  analogWrite(mbf,0);
  analogWrite(mab,0);
  analogWrite(maf,70);
  analogWrite(mbb,0);
  }
 
void back(){
  analogWrite(mbf,0);
  analogWrite(mab,0);
  analogWrite(maf,0);
  analogWrite(mbb,0);

}
void loop(){
if (1){
  if(digitalRead(rso)==0 && digitalRead(lso)==0){
  forward();
  }
  if(digitalRead(rso)==0  && digitalRead(lso)==1){
  left();
  cnt=-1;
  }
  if(digitalRead(rso)==1  && digitalRead(lso)==0){
  right();
  cnt=1;
  }
  if(digitalRead(rso)==1  && digitalRead(lso)==1){
 back();






























































































































































































































































































































































































































































































































































































































































































































































































































  
   
  }
   
}
}
